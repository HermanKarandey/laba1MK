#define BUTTON_PIN  11 //ініціалізую цифровий пін який буду використовувати

boolean buttonWasUp = true;  // була кнопка відпущена?
boolean ledEnabled = false;  // включен ли свет?

void setup() { //setup виконується 1 раз при подачі живлення на мікроконтроллер
  for (int i = 2; i < 10; ++i)
  {
    pinMode(i, OUTPUT);//вказую, що данна послідовність пінів буде працювати як вихід, сигнал йде з мікроконтроллера
  }
  pinMode(BUTTON_PIN, INPUT_PULLUP);//вказую, що цей під буде зчитувати рівень вхідного сигналу
}

void loop() { // постійно виконується при подачі живлення loop
  //---------------------------------------------------------------------------
  //перевіряє 1 клік кнопки
  boolean buttonIsUp = digitalRead(BUTTON_PIN);
  if (buttonWasUp && !buttonIsUp) {
    delay(10);
    buttonIsUp = digitalRead(BUTTON_PIN);
    if (!buttonIsUp) {
      //----------------------------------------------------------------------------
      //запускає цикл послідовного вмикання світодіодів
      for (int i = 2; i < 10; ++i)
      {
        digitalWrite(i, HIGH);// вмикає світодіод
        delay(800);
        digitalWrite(i, LOW);// гасить світодіод
        delay(50);
      }
      //----------------------------------------------------------------------------
    }
  }
  buttonWasUp = buttonIsUp;//зберігає останнє положення кнопки
}
